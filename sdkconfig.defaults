## sdkconfig.defaults
```kconfig
# Heap Poisoning Configuration
CONFIG_HEAP_POISONING_DISABLED=n
CONFIG_HEAP_POISONING_LIGHT=y
# oder CONFIG_HEAP_POISONING_COMPREHENSIVE=y für maximalen Schutz (langsamer/großer RAM-Verbrauch)
CONFIG_HEAP_TASK_TRACKING=y
CONFIG_ARDUINO_LOOP_STACK_SIZE=16384

# Core Dump Configuration
CONFIG_ESP32_ENABLE_COREDUMP=y
CONFIG_ESP32_ENABLE_COREDUMP_TO_UART=y
CONFIG_ESP32_COREDUMP_DATA_FORMAT_ELF=y
CONFIG_ESP32_COREDUMP_CHECKSUM_SHA256=y

# SPIFFS Configuration
CONFIG_SPIFFS_CACHE=y
CONFIG_SPIFFS_CACHE_WR=y
CONFIG_SPIFFS_GC_MAX_RUNS=64
CONFIG_SPIFFS_PAGE_SIZE=256
CONFIG_SPIFFS_OBJ_NAME_LEN=32
CONFIG_SPIFFS_USE_MAGIC=y
CONFIG_SPIFFS_USE_MAGIC_LENGTH=y
```
